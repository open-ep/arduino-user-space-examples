/*
 * PixPaper 2.13" mono (250x122) on UIAPduino Pro Micro CH32V003 V1.4
 *
 * Port of nxp/user-space-examples/2.13/mono/spi/pixpaper-213-m-test-frdm-imx93.c
 * (mono mode) to the openwch/UIAP arduino_core_ch32 core.
 *
 * CH32V003 has 2KB SRAM / 16KB flash: there is no framebuffer. The image is a
 * pre-packed 1bpp const array in flash (generated by png2packed.py) and is
 * streamed straight into the panel controller's RAM over SPI.
 *
 * IMPORTANT: the board must be set to 3.3V (Volt-Sel jumper). At the default 5V
 * the GPIO/SPI logic over-drives the 3.3V panel (faint image + back-feed).
 *
 * Wiring (CH32V003 SPI1 fixed pins + freely chosen control GPIOs):
 *   panel DIN  -> PC6 (MOSI)
 *   panel CLK  -> PC5 (SCK)
 *   panel CS   -> PC4
 *   panel DC   -> PC3
 *   panel RST  -> PD0
 *   panel BUSY -> PD2
 *   VCC -> 3V3, GND -> GND
 */

#include <SPI.h>
#include "img_packed.h"

#define EPD_CS_PIN PC4
#define EPD_DC_PIN PC3
#define EPD_RST_PIN PD0
#define EPD_BUSY_PIN PD2

#define EPD_BYTES (250 * 16)

void epd_writeCommand(uint8_t command) {
	digitalWrite(EPD_DC_PIN, LOW);
	delayMicroseconds(1);
	digitalWrite(EPD_CS_PIN, LOW);
	SPI.transfer(command);
	digitalWrite(EPD_CS_PIN, HIGH);
}

void epd_writeData(uint8_t data) {
	digitalWrite(EPD_DC_PIN, HIGH);
	delayMicroseconds(1);
	digitalWrite(EPD_CS_PIN, LOW);
	SPI.transfer(data);
	digitalWrite(EPD_CS_PIN, HIGH);
}

// Wait for the panel to finish (BUSY high = busy). Times out after 5s so a
// missing/mis-wired BUSY can't hang the sketch.
void epd_waitUntilIdle() {
	delay(2);
	unsigned long start = millis();
	while (digitalRead(EPD_BUSY_PIN) != LOW) {
		if (millis() - start > 5000)
			break;
	}
}

void epd_HWreset() {
	delay(50);
	digitalWrite(EPD_RST_PIN, LOW);
	delay(50);
	digitalWrite(EPD_RST_PIN, HIGH);
	delay(50);
}

void epd_init() {
	epd_HWreset();
	delay(1000);
	epd_waitUntilIdle();

	epd_writeCommand(0x12);
	epd_waitUntilIdle();

	epd_writeCommand(0x01);
	epd_writeData(0xF9);
	epd_writeData(0x00);
	epd_writeData(0x00);

	epd_writeCommand(0x11);
	epd_writeData(0x01);

	epd_writeCommand(0x44);
	epd_writeData(0x00);
	epd_writeData(0x0F);

	epd_writeCommand(0x45);
	epd_writeData(0xF9);
	epd_writeData(0x00);
	epd_writeData(0x00);
	epd_writeData(0x00);

	epd_writeCommand(0x3C);
	epd_writeData(0x05);

	epd_writeCommand(0x21);
	epd_writeData(0x00);
	epd_writeData(0x80);

	epd_writeCommand(0x18);
	epd_writeData(0x80);

	epd_writeCommand(0x4E);
	epd_writeData(0x00);

	epd_writeCommand(0x4F);
	epd_writeData(0xF9);
	epd_writeData(0x00);

	epd_waitUntilIdle();
}

void epd_write_img(const uint8_t *packed) {
	epd_writeCommand(0x24);
	delay(10);

	for (uint16_t i = 0; i < EPD_BYTES; i++)
		epd_writeData(packed[i]);

	epd_writeCommand(0x22);
	delay(10);
	epd_writeData(0xF7);
	epd_writeCommand(0x20);
	epd_waitUntilIdle();
}

void setup() {
	pinMode(EPD_CS_PIN, OUTPUT);
	pinMode(EPD_DC_PIN, OUTPUT);
	pinMode(EPD_RST_PIN, OUTPUT);
	pinMode(EPD_BUSY_PIN, INPUT);
	digitalWrite(EPD_CS_PIN, HIGH);
	digitalWrite(EPD_RST_PIN, LOW);

	SPI.begin();
	SPI.beginTransaction(SPISettings(5000000, MSBFIRST, SPI_MODE0));

	epd_init();
	epd_write_img(img_packed);

	// deep sleep: image stays on screen, panel draws ~uA
	epd_writeCommand(0x10);
	epd_writeData(0x01);
}

void loop() {
}
