/*
 * PixPaper 2.13" 4-color (250x122, black/white/yellow/red) on
 * UIAPduino Pro Micro CH32V003 V1.4
 *
 * Port of nxp/user-space-examples/2.13/color/spi/pixpaper-213-c-test-frdm-imx93.c
 * to the UIAP arduino_core_ch32 core. Same wiring as the mono sketch.
 *
 * The image is a pre-packed 2bpp const array in flash (8000 bytes, generated by
 * png2packed_color.py) streamed straight to the controller - no framebuffer.
 *
 * NOTE (vs mono): different controller. BUSY polarity is INVERTED here:
 * idle = HIGH, busy = LOW. The 4-color refresh takes ~15-25 s - be patient.
 *
 * IMPORTANT: the board must be set to 3.3V (Volt-Sel jumper).
 *
 * Wiring (same as mono):
 *   panel DIN  -> PC6 (MOSI)
 *   panel CLK  -> PC5 (SCK)
 *   panel CS   -> PC4
 *   panel DC   -> PC3
 *   panel RST  -> PD0 (pin 10)
 *   panel BUSY -> PD2
 *   VCC -> 3V3, GND -> GND
 */

#include "img_packed.h"

#define EPD_CS_PIN PC4
#define EPD_DC_PIN PC3
#define EPD_RST_PIN PD0
#define EPD_BUSY_PIN PD2

// image stores 31 bytes/column (rows 0-123); rows 124-127 are a constant 0xFF
// written at runtime, saving 250 bytes of flash
#define EPD_COL_BYTES 31

// Bit-banged SPI mode 0 on SCK=PC5 / MOSI=PC6, driven by direct GPIO register
// writes. The Arduino SPI library + its HAL don't fit in flash next to the 8KB
// image without LTO (and LTO builds don't boot on this board), and the panel is
// a slow write-only device, so hardware SPI buys nothing here.
static void spi_out(uint8_t b) {
	for (uint8_t i = 0; i < 8; i++) {
		if (b & 0x80)
			GPIOC->BSHR = (1 << 6);   // MOSI high
		else
			GPIOC->BCR = (1 << 6);    // MOSI low
		GPIOC->BSHR = (1 << 5);       // SCK high (panel samples this edge)
		b <<= 1;
		GPIOC->BCR = (1 << 5);        // SCK low
	}
}

// single shared writer (flash is tight: 8KB image + code in 16KB)
void epd_write(uint8_t dc, uint8_t b) {
	digitalWrite(EPD_DC_PIN, dc);
	delayMicroseconds(1);
	digitalWrite(EPD_CS_PIN, LOW);
	spi_out(b);
	digitalWrite(EPD_CS_PIN, HIGH);
}

#define epd_writeCommand(c) epd_write(LOW, (c))
#define epd_writeData(d) epd_write(HIGH, (d))

// This controller idles HIGH (busy = LOW) - inverted vs the mono panel.
// 30s timeout covers the long 4-color refresh without hanging forever.
void epd_waitUntilIdle() {
	delay(2);
	unsigned long start = millis();
	while (digitalRead(EPD_BUSY_PIN) != HIGH) {
		if (millis() - start > 30000)
			break;
	}
}

void epd_HWreset() {
	delay(50);
	digitalWrite(EPD_RST_PIN, LOW);
	delay(50);
	digitalWrite(EPD_RST_PIN, HIGH);
	delay(50);
}

// Init sequence as {cmd, ndata, data...} records (table-driven to fit the
// 16KB flash next to the 8KB image). Same commands/values as the reference.
static const uint8_t INIT_SEQ[] = {
	0x4D, 1, 0x78,
	0x00, 2, 0b00001111, 0b00001001,             // PSR
	0x01, 6, 0x07, 0x00, 0x22, 0x78, 0x0A, 0x22, // PWRR
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	0xE9, 1, 0x01,
};

void epd_init() {
	epd_HWreset();
	delay(1000);
	epd_waitUntilIdle();

	for (uint16_t i = 0; i < sizeof(INIT_SEQ);) {
		epd_writeCommand(INIT_SEQ[i]);
		uint8_t n = INIT_SEQ[i + 1];
		for (uint8_t k = 0; k < n; k++)
			epd_writeData(INIT_SEQ[i + 2 + k]);
		epd_waitUntilIdle();
		i += 2 + n;
	}
}

// power on + refresh + park, shared by both frame writers
void epd_refresh() {
	epd_waitUntilIdle();

	epd_writeCommand(0x04);   // power on
	delay(10);
	epd_writeData(0x00);
	epd_waitUntilIdle();

	epd_writeCommand(0x12);   // refresh (takes ~15-25 s)
	delay(10);
	epd_writeData(0x00);
	epd_waitUntilIdle();

	// as in the reference: park the panel after update
	digitalWrite(EPD_RST_PIN, LOW);
	digitalWrite(EPD_DC_PIN, LOW);
}

void epd_write_img(const uint8_t *packed) {
	epd_writeCommand(0x10);
	delay(10);

	for (uint16_t x = 0; x < 250; x++) {
		for (uint8_t j = 0; j < EPD_COL_BYTES; j++)
			epd_writeData(packed[x * EPD_COL_BYTES + j]);
		epd_writeData(0xFF);   // rows 124-127 (outside the 122-row panel)
	}

	epd_refresh();
}

// 4 vertical bars, left to right: black / white / red / yellow. Generated on
// the fly - a bar column is one repeated byte (4 pixels of the same color),
// so this frame costs no flash storage.
void epd_write_bars() {
	static const uint8_t BAR_BYTES[4] = {0x00, 0x55, 0xFF, 0xAA};

	epd_writeCommand(0x10);
	delay(10);

	for (uint16_t x = 0; x < 250; x++) {
		uint16_t col = 249 - x;   // same horizontal mirror as the image stream
		uint8_t b = BAR_BYTES[(col * 4) / 250];
		for (uint8_t j = 0; j < 32; j++)
			epd_writeData(b);
	}

	epd_refresh();
}

void setup() {
	pinMode(EPD_CS_PIN, OUTPUT);
	pinMode(EPD_DC_PIN, OUTPUT);
	pinMode(EPD_RST_PIN, OUTPUT);
	pinMode(EPD_BUSY_PIN, INPUT);
	pinMode(PC5, OUTPUT);   // SCK (bit-banged)
	pinMode(PC6, OUTPUT);   // MOSI (bit-banged)
	digitalWrite(EPD_CS_PIN, HIGH);
	digitalWrite(EPD_RST_PIN, LOW);
	digitalWrite(PC5, LOW); // SPI mode 0: clock idles low
}

// Alternate image / color bars with a 30 s pause between frames. The panel is
// parked (RST low) after each refresh, so re-init every cycle like the Linux
// reference does.
void loop() {
	epd_init();
	epd_write_img(img_packed);
	delay(30000);

	epd_init();
	epd_write_bars();
	delay(30000);
}
